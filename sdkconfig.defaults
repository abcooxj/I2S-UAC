## sdkconfig.defaults
```kconfig
CONFIG_UAC_SPEAKER_CHANNEL_NUM=2
CONFIG_UAC_MIC_CHANNEL_NUM=2
CONFIG_UAC_SAMPLE_RATE=48000
CONFIG_UAC_BIT_RESOLUTION_32=y
CONFIG_UAC_BIT_RESOLUTION=32
CONFIG_UAC_BYTES_PER_SAMPLE=4
```
